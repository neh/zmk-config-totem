//
//                                                        ▀▀▀▀▀     ▀▀▀▀▀          ▀▀█▀▀
//                                                        ▄▀▀▀▄  ▄  ▄▀▀▀▄  ▄  ▄▀▀▀▄  █  ▄▀▀▀▄
//                                                        █   █  █  █   █  █  █   █  █  █   █
//                                                         ▀▀▀   █   ▀▀▀   █   ▀▀▀   ▀   ▀▀▀
//                                                               █      ▄▄▄█▄▄▄    █   █  
//                                                               ▀      █  █  █     █▄█
//                                                             ▀▀▀▀▀    █  █  █      ▀
//                                                                      ▀  ▀  ▀
//
// ▄▄▄▄▄▄▄▄▄▄▄▄▄▄▄▄▄▄▄▄▄▄▄▄▄▄▄▄▄▄▄▄▄▄▄▄▄▄▄▄▄▄▄▄▄▄▄▄▄▄▄▄▄▄▄▄▄▄▄▄▄▄▄▄▄▄▄▄▄▄▄▄▄▄▄▄▄▄▄▄▄▄▄▄▄▄▄▄▄▄▄▄▄▄▄▄▄▄▄▄▄▄▄▄▄▄▄▄▄▄▄▄▄▄▄▄▄▄▄▄▄▄▄▄▄▄▄▄▄▄▄▄▄▄▄▄▄▄▄▄▄▄▄▄▄▄▄▄▄
       

#include <behaviors.dtsi>
#include <dt-bindings/zmk/keys.h>
#include <dt-bindings/zmk/bt.h>
#include <dt-bindings/zmk/outputs.h>

#define _BT_SEL_KEYS_                                                        \
  &out OUT_BLE &bt BT_SEL 0 &bt BT_SEL 1 &bt BT_SEL 2 &bt BT_SEL 3

#include "zmk-helpers/helper.h"

#define BASE 0
#define GAME 1
#define NAV  2
#define SYM  3
#define GYM  4
#define FUN  5

#include "keypos_38keys.h"
#define KEYS_L LT0 LT1 LT2 LT3 LT4 LM0 LM1 LM2 LM3 LM4 LB0 LB1 LB2 LB3 LB4 LH4 // left hand
#define KEYS_R RT0 RT1 RT2 RT3 RT4 RM0 RM1 RM2 RM3 RM4 RB0 RB1 RB2 RB3 RB4 RH4 // right hand
#define THUMBS LH2 LH1 LH0 RH0 RH1 RH2                                         // thumbs

#define QUICK_TAP_MS 175

#define MAKE_HRM(NAME, HOLD, TAP, TRIGGER_POS)                                 \
  ZMK_HOLD_TAP(NAME, bindings = <HOLD>, <TAP>; flavor = "balanced";            \
               tapping-term-ms = <280>; quick-tap-ms = <QUICK_TAP_MS>;         \
               require-prior-idle-ms = <150>; hold-trigger-on-release;         \
               hold-trigger-key-positions = <TRIGGER_POS>;)

MAKE_HRM(hml, &kp, &kp, KEYS_R THUMBS) // Left-hand HRMs.
MAKE_HRM(hmr, &kp, &kp, KEYS_L THUMBS) // Right-hand HRMs.

&mt {
  quick-tap-ms = <100>;
  global-quick-tap;
  flavor = "tap-preferred";
  tapping-term-ms = <170>;
};

// Define mod-morph with a *single* mod trigger for less repetition.
#define SIMPLE_MORPH(NAME, MOD, BINDING1, BINDING2)                            \
  ZMK_MOD_MORPH(NAME, mods = <(MOD_L##MOD | MOD_R##MOD)>;                      \
                bindings = <BINDING1>, <BINDING2>;)

SIMPLE_MORPH(comsem, SFT, &kp COMMA, &kp SEMICOLON)
SIMPLE_MORPH(dotcol, SFT, &kp DOT, &kp COLON)
SIMPLE_MORPH(quebng, SFT, &kp QUESTION, &kp EXCLAMATION)
SIMPLE_MORPH(slashy, SFT, &kp SLASH, &kp BACKSLASH)

#define COMBO_TERM_FAST 18
#define COMBO_TERM_SLOW 35

#define COMBO_IDLE_FAST 150
#define COMBO_IDLE_SLOW 50

ZMK_COMBO(esc,   &kp ESC,      LB3 LB2,     BASE NAV SYM, COMBO_TERM_FAST, COMBO_IDLE_FAST)
ZMK_COMBO(ret,   &kp ENTER,    RB3 RB2,     BASE NAV SYM, COMBO_TERM_FAST, COMBO_IDLE_FAST)
ZMK_COMBO(tab,   &kp TAB,      RB1 RB2,     BASE NAV SYM, COMBO_TERM_SLOW, COMBO_IDLE_FAST)

#define PTAB &kp LC(LS(TAB))
#define NTAB &kp LC(TAB)

#define VOLU &kp C_VOL_UP
#define VOLD &kp C_VOL_DN

#define HRML(k1,k2,k3,k4) &hml LSHFT k1 &hml LALT k2 &hml LCTRL k3 &hml LGUI k4
#define HRMR(k1,k2,k3,k4) &hmr LGUI k1 &hmr LCTRL k2 &hmr LALT k3 &hmr LSHFT k4

#define AS(keycode) &as keycode keycode

/ {
    behaviors {
        as: auto_shift {
            compatible = "zmk,behavior-hold-tap";
            #binding-cells = <2>;
            tapping_term_ms = <195>;
            quick_tap_ms = <0>;
            flavor = "tap-preferred";
            bindings = <&kp>, <&kp>;
        };
    };

    macros {
        gif: gif {
            label = "giphy";
            compatible = "zmk,behavior-macro";
            #binding-cells = <0>;
            bindings
                = <&macro_press &kp LSHFT>
                , <&macro_tap &kp N2>
                , <&macro_release &kp LSHFT>
                , <&macro_tap &kp G &kp I &kp F>
                ;
        };
    };

        keymap {
                compatible = "zmk,keymap";
// ▄▄▄▄▄▄▄▄▄▄▄▄▄▄▄▄▄▄▄▄▄▄▄▄▄▄▄▄▄▄▄▄▄▄▄▄▄▄▄▄▄▄▄▄▄▄▄▄▄▄▄▄▄▄▄▄▄▄▄▄▄▄▄▄▄▄▄▄▄▄▄▄▄▄▄▄▄▄▄▄▄▄▄▄▄▄▄▄▄▄▄▄▄▄▄▄▄▄▄▄▄▄▄▄▄▄▄▄▄▄▄▄▄▄▄▄▄▄▄▄▄▄▄▄▄▄▄▄▄▄▄▄▄▄▄▄▄▄▄▄▄▄▄▄▄▄▄▄▄

                base_layer {
// ┏━━━━━━━━━━━━━━━━━━━━━━━━━━━━━━━━━━━━━━━┓
label= "BASE"                              ;
// ┗━━━━━━━━━━━━━━━━━━━━━━━━━━━━━━━━━━━━━━━┛
 bindings = <
// ╷           ╷            ╷           ╷            ╷           ╷           ╷   ╷           ╷           ╷            ╷           ╷            ╷           ╷

                AS(SQT)      AS(X)       &comsem      &dotcol     AS(EQUAL)       &slashy     AS(L)       AS(D)        AS(W)       AS(V)
                HRML(C,      I,          E,           A)          &kp MINUS       AS(K)       HRMR(H,     T,           N,          S)
    AS(Q)       AS(B)        AS(Y)       AS(U)        AS(O)       &quebng         AS(J)       AS(M)       AS(G)        AS(P)       AS(F)        AS(Z)
                                       &lt NAV ENTER  &kp LSHFT   &lt SYM ESC     &lt FUN BSPC   &lt SYM SPACE   AS(R)
                        >;
                };

// ▄▄▄▄▄▄▄▄▄▄▄▄▄▄▄▄▄▄▄▄▄▄▄▄▄▄▄▄▄▄▄▄▄▄▄▄▄▄▄▄▄▄▄▄▄▄▄▄▄▄▄▄▄▄▄▄▄▄▄▄▄▄▄▄▄▄▄▄▄▄▄▄▄▄▄▄▄▄▄▄▄▄▄▄▄▄▄▄▄▄▄▄▄▄▄▄▄▄▄▄▄▄▄▄▄▄▄▄▄▄▄▄▄▄▄▄▄▄▄▄▄▄▄▄▄▄▄▄▄▄▄▄▄▄▄▄▄▄▄▄▄▄▄▄▄▄▄▄▄

                game_layer {
// ┏━━━━━━━━━━━━━━━━━━━━━━━━━━━━━━━━━━━━━━━┓
label= "GAME"                              ;
// ┗━━━━━━━━━━━━━━━━━━━━━━━━━━━━━━━━━━━━━━━┛
 bindings = <
// ╷           ╷            ╷           ╷            ╷           ╷           ╷   ╷           ╷           ╷            ╷           ╷            ╷           ╷

                &kp SQT      &kp X       &kp COMMA    &kp DOT     &kp EQUAL       &slashy     &kp L       &kp D        &kp W       &kp V
                &kp C        &kp I       &kp E        &kp A       &kp MINUS       &kp K       &kp H       &kp T        &kp N       &kp S
    &kp Q       &kp B        &kp Y       &kp U        &kp O       &kp QUESTION    &kp J       &kp M       &kp G        &kp P       &kp F        &kp Z
                                       &mt LCTRL ENTER  &kp LSHFT   &lt GYM ESC     &lt NAV BSPC   &lt SYM SPACE   &kp R
                        >;
                };

// ▄▄▄▄▄▄▄▄▄▄▄▄▄▄▄▄▄▄▄▄▄▄▄▄▄▄▄▄▄▄▄▄▄▄▄▄▄▄▄▄▄▄▄▄▄▄▄▄▄▄▄▄▄▄▄▄▄▄▄▄▄▄▄▄▄▄▄▄▄▄▄▄▄▄▄▄▄▄▄▄▄▄▄▄▄▄▄▄▄▄▄▄▄▄▄▄▄▄▄▄▄▄▄▄▄▄▄▄▄▄▄▄▄▄▄▄▄▄▄▄▄▄▄▄▄▄▄▄▄▄▄▄▄▄▄▄▄▄▄▄▄▄▄▄▄▄▄▄▄


                nav_layer {
// ┏━━━━━━━━━━━━━━━━━━━━━━━━━━━━━━━━━━━━━━━┓
label= "NAV"                              ;
// ┗━━━━━━━━━━━━━━━━━━━━━━━━━━━━━━━━━━━━━━━┛
 bindings = <
// ╷           ╷           ╷           ╷           ╷           ╷           ╷   ╷           ╷           ╷           ╷           ╷           ╷           ╷

                &trans      VOLU        VOLD        &trans      &trans          &trans      PTAB        &kp PG_UP   &kp PG_DN   NTAB
                &kp LSHFT   &kp LALT    &kp LCTRL   &kp LGUI    &kp C_VOL_UP    &trans      &kp LEFT    &kp UP      &kp DOWN    &kp RIGHT
    &trans      &kp C_PREV  &kp C_MUTE  &kp C_PP    &kp C_NEXT  &kp C_VOL_DN    &trans      &kp HOME    &kp PG_UP   &kp PG_DN   &kp END     &trans
                                        &trans      &trans      &trans          &kp BSPC    &kp TAB   &tog GAME
                        >;
                };

// ▄▄▄▄▄▄▄▄▄▄▄▄▄▄▄▄▄▄▄▄▄▄▄▄▄▄▄▄▄▄▄▄▄▄▄▄▄▄▄▄▄▄▄▄▄▄▄▄▄▄▄▄▄▄▄▄▄▄▄▄▄▄▄▄▄▄▄▄▄▄▄▄▄▄▄▄▄▄▄▄▄▄▄▄▄▄▄▄▄▄▄▄▄▄▄▄▄▄▄▄▄▄▄▄▄▄▄▄▄▄▄▄▄▄▄▄▄▄▄▄▄▄▄▄▄▄▄▄▄▄▄▄▄▄▄▄▄▄▄▄▄▄▄▄▄▄▄▄▄


                sym_layer {
// ┏━━━━━━━━━━━━━━━━━━━━━━━━━━━━━━━━━━━━━━━┓
label= "SYM"                               ;
// ┗━━━━━━━━━━━━━━━━━━━━━━━━━━━━━━━━━━━━━━━┛
 bindings = <
// ╷           ╷           ╷           ╷           ╷           ╷           ╷   ╷           ╷           ╷           ╷           ╷           ╷           ╷

                &kp PERCENT &kp CARET   &kp N0      &kp N9      &kp AMPS        &kp TILDE   &kp GRAVE    &kp LS(LBKT)  &kp LS(RBKT) &trans
                HRML(N4,    N3,         N2,         N1)         &kp DOLLAR      &kp PIPE    HRMR(LS(N9), LBKT,         RBKT,        LS(N0))
    &trans      &kp N8      &kp N7      &kp N6      &kp N5      &kp HASH        &kp AT      &kp STAR     &kp LS(COMMA) &kp LS(DOT)  &trans  &trans
                                        &trans      &trans        &trans         &trans      &trans    &trans
                        >;
                };

// ▄▄▄▄▄▄▄▄▄▄▄▄▄▄▄▄▄▄▄▄▄▄▄▄▄▄▄▄▄▄▄▄▄▄▄▄▄▄▄▄▄▄▄▄▄▄▄▄▄▄▄▄▄▄▄▄▄▄▄▄▄▄▄▄▄▄▄▄▄▄▄▄▄▄▄▄▄▄▄▄▄▄▄▄▄▄▄▄▄▄▄▄▄▄▄▄▄▄▄▄▄▄▄▄▄▄▄▄▄▄▄▄▄▄▄▄▄▄▄▄▄▄▄▄▄▄▄▄▄▄▄▄▄▄▄▄▄▄▄▄▄▄▄▄▄▄▄▄▄


                gym_layer {
// ┏━━━━━━━━━━━━━━━━━━━━━━━━━━━━━━━━━━━━━━━┓
label= "GYM"                               ;
// ┗━━━━━━━━━━━━━━━━━━━━━━━━━━━━━━━━━━━━━━━┛
 bindings = <
// ╷           ╷           ╷           ╷           ╷           ╷           ╷   ╷           ╷           ╷           ╷           ╷           ╷           ╷

                &kp PERCENT &kp CARET   &kp N0      &kp N9      &kp AMPS        &kp TILDE   &kp GRAVE    &kp LS(LBKT)  &kp LS(RBKT) &trans
                &kp N4      &kp N3      &kp N2      &kp N1      &kp DOLLAR      &kp PIPE    HRMR(LS(N9), LBKT,         RBKT,        LS(N0))
    &trans      &kp N8      &kp N7      &kp N6      &kp N5      &kp HASH        &kp AT      &kp STAR     &kp LS(COMMA) &kp LS(DOT)  &trans  &trans
                                        &trans      &trans        &trans         &trans      &trans    &trans
                        >;
                };
// ▄▄▄▄▄▄▄▄▄▄▄▄▄▄▄▄▄▄▄▄▄▄▄▄▄▄▄▄▄▄▄▄▄▄▄▄▄▄▄▄▄▄▄▄▄▄▄▄▄▄▄▄▄▄▄▄▄▄▄▄▄▄▄▄▄▄▄▄▄▄▄▄▄▄▄▄▄▄▄▄▄▄▄▄▄▄▄▄▄▄▄▄▄▄▄▄▄▄▄▄▄▄▄▄▄▄▄▄▄▄▄▄▄▄▄▄▄▄▄▄▄▄▄▄▄▄▄▄▄▄▄▄▄▄▄▄▄▄▄▄▄▄▄▄▄▄▄▄▄


                fun_layer {
// ┏━━━━━━━━━━━━━━━━━━━━━━━━━━━━━━━━━━━━━━━┓
label= "FUN"                               ;
// ┗━━━━━━━━━━━━━━━━━━━━━━━━━━━━━━━━━━━━━━━┛
 bindings = <
// ╷           ╷           ╷           ╷           ╷           ╷           ╷   ╷           ╷           ╷           ╷           ╷           ╷           ╷

                &kp F12     &kp F11     &kp F10     &kp F9      &trans          _BT_SEL_KEYS_
                &kp F4      &kp F3      &kp F2      &kp F1      &trans          &out OUT_USB &kp F4      &kp F5      &kp F6      &kp F11
    &trans      &kp F8      &kp F7      &kp F6      &kp F5      &trans          &trans       &kp F1      &kp F2      &kp F3      &kp F10     &trans
                                        &trans      &trans      &trans          &trans       &trans      &trans
                        >;
                };
        };
};
